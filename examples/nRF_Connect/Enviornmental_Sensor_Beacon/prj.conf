## CMakeLists.txt
```
cmake_minimum_required(VERSION 3.20.0)

# ---------------------------------------------------------------------------
# Auto-fetch HMS_BLE + ChronoLog modules (GitHub) into Modules/ if missing.
# ---------------------------------------------------------------------------

# ---- Fetch HMS_BLE if missing ----
if(NOT EXISTS "${CMAKE_CURRENT_SOURCE_DIR}/Modules/HMS_BLE/CMakeLists.txt")
    message(STATUS "Fetching HMS_BLE module (GitHub)...")
    file(MAKE_DIRECTORY "${CMAKE_CURRENT_SOURCE_DIR}/Modules")
    execute_process(
        COMMAND git clone --depth 1
                https://github.com/Hamas888/HMS_BLE.git
                "${CMAKE_CURRENT_SOURCE_DIR}/Modules/HMS_BLE"
        RESULT_VARIABLE HMS_BLE_FETCH_RESULT
        OUTPUT_QUIET ERROR_QUIET
    )
    if(NOT HMS_BLE_FETCH_RESULT EQUAL 0)
        message(FATAL_ERROR "Failed to auto-fetch HMS_BLE from GitHub.")
    endif()
endif()

# ---- Fetch ChronoLog if missing ----
if(NOT EXISTS "${CMAKE_CURRENT_SOURCE_DIR}/Modules/ChronoLog/CMakeLists.txt")
    message(STATUS "Fetching ChronoLog module (GitHub)...")
    file(MAKE_DIRECTORY "${CMAKE_CURRENT_SOURCE_DIR}/Modules")
    execute_process(
        COMMAND git clone --depth 1
                https://github.com/Hamas888/ChronoLog.git
                "${CMAKE_CURRENT_SOURCE_DIR}/Modules/ChronoLog"
        RESULT_VARIABLE CHRONOLOG_FETCH_RESULT
        OUTPUT_QUIET ERROR_QUIET
    )
    if(NOT CHRONOLOG_FETCH_RESULT EQUAL 0)
        message(FATAL_ERROR "Failed to auto-fetch ChronoLog from GitHub.")
    endif()
endif()

# ---------------------------------------------------------------------------
# Config overlays BEFORE find_package(Zephyr)
# ---------------------------------------------------------------------------
set(CONF_FILE
    "prj.conf;Modules/HMS_BLE/HMS_BLE.conf")

find_package(Zephyr REQUIRED HINTS $ENV{ZEPHYR_BASE})

project(BLE_lib_dev)

# Force C++17 support for HMS_BLE library
add_compile_options($<$<COMPILE_LANGUAGE:CXX>:-std=c++17>)

# Add HMS_BLE + ChronoLog as subdirectories
add_subdirectory(Modules/HMS_BLE)
add_subdirectory(Modules/ChronoLog)

# Link HMS_BLE + ChronoLog library to app
target_link_libraries(app PRIVATE HMS_BLE ChronoLog)

# Add HMS_BLE include directory
target_include_directories(app PRIVATE Modules/HMS_BLE/include)

target_sources(app PRIVATE src/main.cpp)
```

## Kconfig
```
source "Kconfig.zephyr"

# Application Kconfig — sources HMS_BLE module options
rsource "Modules/HMS_BLE/Kconfig"
rsource "Modules/ChronoLog/Kconfig"
```

## west.yml
```
# HMS_BLE Environmental Sensor Beacon example — standalone workspace manifest.
#
# Copy this example folder anywhere, then set up a fresh workspace:
#
#   west init -m . --mf west.yml .
#   west update
#   west build -b nrf54l15dk/nrf54l15/cpuapp -d build
#
# west fetches the nRF Connect SDK (ncs + zephyr) and the two Hamas888
# modules (HMS_BLE, ChronoLog) into Modules/, so the example is fully
# self-contained and ready to build. CMake also auto-fetches the modules
# if you skip west and build directly against an existing NCS install.

manifest:
  version: "0.13"

  remotes:
    - name: ncs
      url-base: https://github.com/nrfconnect
    - name: hamas
      url-base: https://github.com/Hamas888

  defaults:
    remote: ncs

  projects:
    # nRF Connect SDK — imports zephyr and all NCS dependencies
    - name: nrf
      repo-path: sdk-nrf
      revision: v3.2.0
      import: true

    # HMS_BLE + ChronoLog as Zephyr modules (auto-fetched)
    - name: hms_ble
      remote: hamas
      repo-path: HMS_BLE
      revision: main
      path: Modules/HMS_BLE

    - name: chronolog
      remote: hamas
      repo-path: ChronoLog
      revision: main
      path: Modules/ChronoLog

  self:
    # The manifest lives in the example project root (the copied folder).
    path: .
```

## prj.conf
```kconfig
# Main project configuration

# ============================================================================
# Note: BLE-specific configurations are managed by HMS_BLE.conf
# C++ standard is enforced at CMakeLists.txt level (more reliable than Kconfig)
# ============================================================================

# Enable C++ support
CONFIG_CPP=y
CONFIG_STD_CPP17=y
CONFIG_GLIBCXX_LIBCPP=y

# ============================================================================
# HMS_BLE control knobs
# ============================================================================
CONFIG_HMS_BLE_DEBUG=y
CONFIG_HMS_BLE_LOG_LEVEL=5
```

## src/main.cpp
```c
#include <zephyr/kernel.h>
#include <zephyr/random/random.h>
#include "HMS_BLE.h"
#include "ChronoLog.h"

/* ===================================================================================================
 *  HMS_BLE Beacon Demo — Environmental Sensor Beacon (Manufacturer-Specific)
 *
 *  Demonstrates:
 *    • Beacon (Broadcaster) mode — non-connectable advertising
 *    • Built-in beacon format builders (iBeacon, Eddystone, Manufacturer)
 *    • Custom manufacturer beacon with live sensor data in AD payload
 *    • API error handling
 *
 *  Beacon format: Manufacturer-specific (Company ID 0xFFFF)
 *    AD payload encodes: data format version (1B) + temperature in °C (2B, LE)
 *                        + humidity in %RH (2B, LE) + battery % (1B) = 6 bytes
 *
 *  Scan: Use nRF Connect / nRF Toolbox / any BLE scanner and look for
 *        manufacturer data on Company ID 0xFFFF.
 * ===================================================================================================*/

// ---- Simulated sensor state (same values as Peripheral demo) ----
static int16_t   temperature     = 2500;               // 25.00°C
static uint16_t  humidity        = 6500;               // 65.00% RH
static uint8_t   batteryLevel    = 85;                 // 85%

static HMS_BLE       *ble        = nullptr;
static ChronoLogger   logger("EnvBeacon");

static int32_t randRange(int32_t min, int32_t max) {
    return min + (int32_t)(sys_rand32_get() % (uint32_t)(max - min + 1));
}

// ==================================== Main ====================================

int main(void) {
    logger.info("=== HMS_BLE Beacon Demo ===");

    // Create in BEACON mode
    ble = new HMS_BLE("HMS-BLE-Beacon", HMS_BLE_MODE_BEACON);

    // Build manufacturer AD payload with sensor data.
    // Format: [version(1)] [temperature_LE(2)] [humidity_LE(2)] [battery(1)] = 6 bytes
    uint8_t adBuf[HMS_BLE_MAX_AD_DATA];
    uint8_t mfgPayload[6];

    mfgPayload[0] = 0x01;                                                           // Data format version
    memcpy(&mfgPayload[1], &temperature, 2);                                        // Temperature (little-endian)
    memcpy(&mfgPayload[3], &humidity,    2);                                        // Humidity (little-endian)
    mfgPayload[5] = batteryLevel;                                                    // Battery %

    size_t adLen = HMS_BLE::buildManufacturerAD(adBuf, sizeof(adBuf),
                                                 0xFFFF,                            // Company ID (test)
                                                 mfgPayload, sizeof(mfgPayload));

    if (adLen == 0) {
        logger.error("Failed to build manufacturer AD");
        return -1;
    }

    HMS_BLE_Status st = ble->setBeaconData(adBuf, adLen);
    if (st != HMS_BLE_STATUS_SUCCESS) {
        logger.error("setBeaconData() failed: %d", st);
        return -1;
    }

    st = ble->begin();
    if (st != HMS_BLE_STATUS_SUCCESS) {
        logger.error("BLE begin() failed: %d", st);
        return -1;
    }

    logger.info("Beacon active — device name: Env-Beacon");
    logger.info("Company ID: 0xFFFF, Sensor data format v%d", mfgPayload[0]);
    logger.info("Scan for manufacturer data on phone");

    // ==================================== Main loop ====================================
    while (1) {
        static int64_t lastUpdate = 0;
        int64_t now = k_uptime_get();

        if (now - lastUpdate >= 5000) {
            lastUpdate = now;

            // Simulate sensor drift (same as Peripheral demo)
            temperature  += randRange(-100, 100);
            humidity     += randRange(-50, 50);
            batteryLevel  = (batteryLevel > 1) ? batteryLevel - 1 : 100;

            temperature   = CLAMP(temperature, 1500, 3500);
            humidity      = CLAMP(humidity,    3000, 9000);

            // Rebuild AD with fresh sensor data
            mfgPayload[0] = 0x01;
            memcpy(&mfgPayload[1], &temperature, 2);
            memcpy(&mfgPayload[3], &humidity,    2);
            mfgPayload[5] = batteryLevel;

            adLen = HMS_BLE::buildManufacturerAD(adBuf, sizeof(adBuf),
                                                 0xFFFF, mfgPayload, sizeof(mfgPayload));

            // Update beacon data (restarts advertising internally)
            if (adLen > 0) {
                ble->setBeaconData(adBuf, adLen);
                logger.info("Beacon updated — Temp: %d.%02d°C, Humidity: %d.%02d%%, Battery: %d%%",
                            temperature / 100, abs(temperature % 100),
                            humidity / 100, humidity % 100,
                            batteryLevel);
            }
        }
        k_msleep(10);
    }
}
```
