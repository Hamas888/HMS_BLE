## examples/nRF_Connect/nRF52/nRF52-832_Enviornmental_Sensor/west.yml
```yaml
manifest:
  version: "0.13"
  
  projects:
    - name: HMS_BLE
      url: https://github.com/Hamas888/HMS_BLE.git
      path: Modules/HMS_BLE
      revision: main
      
    - name: ChronoLog
      url: https://github.com/Hamas888/ChronoLog.git
      path: Modules/ChronoLog
      revision: main

  self:
    path: .
    west-commands: zephyr/scripts/west-commands.yml
```
